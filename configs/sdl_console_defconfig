## configs/sdl_console_defconfig
```kconfig
BR2_arm=y
BR2_DL_DIR="/home/gilles/dl"
BR2_TOOLCHAIN_EXTERNAL=y
BR2_TARGET_GENERIC_HOSTNAME="gbox"
BR2_TARGET_GENERIC_ISSUE="Welcome to your SDL-based game console"
BR2_PACKAGE_SDL=y
BR2_PACKAGE_SDL_GFX=y
BR2_PACKAGE_SDL_IMAGE=y
BR2_PACKAGE_SDL_IMAGE_GIF=y
BR2_PACKAGE_SDL_IMAGE_JPEG=y
BR2_PACKAGE_SDL_IMAGE_PNG=y
BR2_PACKAGE_SDL_IMAGE_TIFF=y
BR2_PACKAGE_SDL_MIXER=y
BR2_PACKAGE_SDL_NET=y
BR2_PACKAGE_SDL_TTF=y
```

## package/Config.in
```kconfig
source "package/busybox/Config.in"

menu "Games packages"

menu "Board Games"
	source "package/gnuchess/Config.in"
endmenu

menu "First Person Shooter"
	source "package/doom-wad/Config.in"
	source "package/hexen2/Config.in"
	source "package/hexen2-pak/Config.in"
	source "package/prboom/Config.in"
endmenu


menu "Platformer & Shoot'em'up"
	source "package/c-dogs/Config.in"
	source "package/edgar/Config.in"
	source "package/paintown/Config.in"
	source "package/opentyrian/Config.in"
	source "package/openjazz/Config.in"
	source "package/opentyrian-data/Config.in"
	source "package/supertux/Config.in"
endmenu


menu "Puzzle"
	source "package/lbreakout2/Config.in"
	source "package/ltris/Config.in"
	source "package/meandmyshadow/Config.in"
	source "package/rezerwar/Config.in"
	source "package/rubix/Config.in"
	source "package/spacejunk/Config.in"
endmenu

endmenu
```

## package/advancemame/Config.in
```kconfig
config BR2_PACKAGE_ADVANCEMAME
	bool "AdvanceMAME"
	select BR2_PACKAGE_SDL
	select BR2_PACKAGE_ZLIB
	select BR2_PACKAGE_SLANG
	select BR2_PACKAGE_EXPAT
	select BR2_PACKAGE_NCURSES
	select BR2_PACKAGE_FREETYPE
	help
	  AdvanceMAME is a port of the MAME and MESS emulators for
	  Arcade Monitors and TVs but also for normal PC Monitors

	  http://advancemame.sourceforge.net/
```

## package/c-dogs/Config.in
```kconfig
config BR2_PACKAGE_C_DOGS
	bool "C-dogs"
	select BR2_PACKAGE_SDL
	select BR2_PACKAGE_SDL_IMAGE
	select BR2_PACKAGE_SDL_MIXER
	select BR2_PACKAGE_SDL_NET
	help
	  C-Dogs SDL is a port of the old DOS arcade game C-Dogs to modern
	  operating systems. C-Dogs is an arcade shoot-em-up which lets players
	  work alone or co-operativly during missions, and against each other
	  in the "dogfight" deathmatch mode.

	  http://cxong.github.io/cdogs-sdl/
```

## package/edgar/Config.in
```kconfig
config BR2_PACKAGE_EDGAR
	bool "Legend of Edgar"
	select BR2_PACKAGE_SDL
	select BR2_PACKAGE_SDL_IMAGE
	select BR2_PACKAGE_SDL_MIXER
	select BR2_PACKAGE_SDL_TTF
	select BR2_PACKAGE_ZLIB
	help
	  OpenJazz is a free, open-source version of the classic
	  Jazz Jackrabbit games.

	  http://www.alister.eu/jazz/oj/

comment "OpenJazz requires a toolchain w/ C++"
	depends on !(BR2_INSTALL_LIBSTDCPP)
```

## package/hexen2-pak/Config.in
```kconfig
config BR2_PACKAGE_HEXEN2_PAK
	bool "Shareware Hexen2 PAK file"
	depends on BR2_PACKAGE_HEXEN2
	help
	  This will install the shareware pak data file for the Hexen2 game.

	  The pak file will be placed in the /usr/games directory.
```

## package/hexen2/Config.in
```kconfig
config BR2_PACKAGE_HEXEN2
	bool "Hexen2"
	select BR2_PACKAGE_SDL
	select BR2_PACKAGE_SDL_MIXER
	help
	  Hexen2: The Hammer of Thyrion project is a cross-platform source port
	  effort of Raven Software's class based shooter game Hexen II and its
	  multiplayer extension HexenWorld

	  http://uhexen2.sourceforge.net/
```

## package/meandmyshadow/Config.in
```kconfig
config BR2_PACKAGE_MEANDMYSHADOW
	bool "Me and my shadow"
	select BR2_PACKAGE_LIBARCHIVE
	select BR2_PACKAGE_LIBCURL
	select BR2_PACKAGE_OPENSSL
	select BR2_PACKAGE_SDL
	select BR2_PACKAGE_SDL_IMAGE
	select BR2_PACKAGE_SDL_GFX
	select BR2_PACKAGE_SDL_MIXER
	select BR2_PACKAGE_SDL_NET

	help
	  Me and My Shadow is a free libre puzzle/platform game in which
	  you try to reach the exit by solving puzzles. Spikes, moving blocks,
	  fragile blocks and much more stand between you and the exit.
	  Record your moves and let your shadow mimic them to reach blocks
	  you couldn't reach alone.

	  http://meandmyshadow.sourceforge.net/
```

## package/openjazz/Config.in
```kconfig
config BR2_PACKAGE_OPENJAZZ
	bool "OpenJazz"
	depends on BR2_INSTALL_LIBSTDCPP
	select BR2_PACKAGE_SDL
	select BR2_PACKAGE_ZLIB
	help
	  OpenJazz is a free, open-source version of the classic
	  Jazz Jackrabbit games.

	  http://www.alister.eu/jazz/oj/

comment "OpenJazz requires a toolchain w/ C++"
	depends on !(BR2_INSTALL_LIBSTDCPP)
```

## package/paintown/Config.in
```kconfig
config BR2_PACKAGE_PAINTOWN
	bool "Paintown"
	select BR2_PACKAGE_FREETYPE
	select BR2_PACKAGE_LIBMAD
	select BR2_PACKAGE_LIBOGG
	select BR2_PACKAGE_LIBVORBIS
	select BR2_PACKAGE_MPG123
	select BR2_PACKAGE_SDL
	select BR2_PACKAGE_SDL_IMAGE
	select BR2_PACKAGE_SDL_MIXER
	select BR2_PACKAGE_SDL_NET
	help
	  Paintown is a free and open source 2-d fighting game

	  http://paintown.sourceforge.net/
```

## package/rezerwar/Config.in
```kconfig
config BR2_PACKAGE_REZERWAR
	bool "Rezerwar"
	select BR2_PACKAGE_SDL
	select BR2_PACKAGE_SDL_MIXER
	help
	  rezerwar is a puzzle game that could be described as the illegitimate
	  child of a known tetromino game and the average pipe game

	  http://tamentis.com/projects/rezerwar/
```

## package/spacejunk/Config.in
```kconfig
config BR2_PACKAGE_SPACEJUNK
	bool "Spacejunk"
	select BR2_PACKAGE_SDL
	select BR2_PACKAGE_SDL_MIXER
	help
	  Spacejunk is a computer game about traveling in 2D planetary systems.
	  The player must collect drifting garbage by navigating through the
	  gravitational fields of planets and stars.

	  http://spacejunk.sourceforge.net/
```

## package/supertux/Config.in
```kconfig
config BR2_PACKAGE_SUPERTUX
       bool "Supertux"
       select BR2_PACKAGE_SDL
       select BR2_PACKAGE_SDL_IMAGE
       select BR2_PACKAGE_SDL_IMAGE_XPM
       select BR2_PACKAGE_SDL_IMAGE_PNG
       select BR2_PACKAGE_SDL_IMAGE_JPEG
       select BR2_PACKAGE_SDL_MIXER
       select BR2_PACKAGE_ZLIB
       help
         SuperTux is a classic 2D jump'n run sidescroller game in a style
         similar to the original SuperMario games
         This only builds the 0.1.3 version of Supertux

         http://supertux.lethargik.org/

if BR2_PACKAGE_SUPERTUX

config BR2_PACKAGE_SUPERTUX_NOOPENGL
       bool "Disable OpenGL support"
       default y

endif
```
